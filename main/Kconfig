## main/Kconfig
```kconfig
menu "Firmware"

config FIRMWARE_USE_AMP
    bool "Enable Amplifier Support"
    depends on MAX9744_ESPIDF_ENABLED
    default true
    help
        Enable Amplifier Support via MAX9744

config FIRMWARE_USE_MDNS
    bool "Enable mDNS broadcasts"
    default false
    help
        Enable mDNS broadcasts for web service


config FIRMWARE_USE_AWS
    bool "Enable AWS"
    depends on AWS_IOT_SDK
    default true
    help
        Enable AWS support


config FIRMWARE_USE_HOMEKIT
    bool "Enable Homekit"
    depends on FIRMWARE_USE_TEMPERATURE
    default true
    help
        Enable Homekit support


config FIRMWARE_USE_OTA
    bool "Enable OTA updater"
    default true
    help
        Enable OTA updater

config FIRMWARE_OTA_MANIFEST_URL
    string "OTA update manifest URL"
    depends on FIRMWARE_USE_OTA
    default ""
    help
        OTA update manifest URL

config FIRMWARE_USE_WEB
    bool "Enable Web"
    default true
    help
        Enables Web interface

config FIRMWARE_WEB_MAX_CONNECTIONS
    int "Maximum simultaneous web connections"
    depends on FIRMWARE_USE_WEB
    default 5
    help
        Maximum simultaneous web connections

config FIRMWARE_WEB_PORT
    int "Listen port for web interface"
    depends on FIRMWARE_USE_WEB
    default 80
    help
        Listen port for web interface

config FIRMWARE_USE_WEB_WEBSOCKET
    bool "Enable Websockets in web interface"
    depends on FIRMWARE_USE_WEB
    default true
    help
        Enable Websockets in web interface


config FIRMWARE_USE_TEMPERATURE
    bool "Enable Temperature Sensor"
    default true
    help
        Enable temperature sensor support via si7021


config FIRMWARE_USE_CONSOLE
    bool "Enable console interface"
    default false
    help
        Enable console interface

config FIRMWARE_HARDCODE_WIFI
    bool "Hardcode wifi credentials"
    default false
    help
        Builds wifi credentials into firmware binary

config FIRMWARE_DEFAULT_VOLUME
    int "Default volume level"
    depends on FIRMWARE_USE_AMP
    default 27
    help
        Default volume level

config FIRMWARE_MINIMUM_VOLUME
    int "Minimum volume level"
    depends on FIRMWARE_USE_AMP
    default 0
    help
        Minimum volume level

config FIRMWARE_MAXIMUM_VOLUME
    int "Maximum volume level"
    depends on FIRMWARE_USE_AMP
    default 63
    help
        Maximum volume level


config FIRMWARE_ERROR_GPIO
    int "GPIO for error LED"
    default 16
    help
        GPIO for error LED

config FIRMWARE_READY_GPIO
    int "GPIO for ready LED"
    default 17
    help
        GPIO for ready LED

config FIRMWARE_IDENTIFY_GPIO
    int "GPIO for identify LED"
    default 18
    help
        GPIO for identify LED

endmenu
```

## main/Kconfig.projbuild
```kconfig
menu "Firmware"

config FIRMWARE_USE_AMP
    bool "Enable Amplifier Support"
    depends on MAX9744_ESPIDF_ENABLED
    default false
    help
        Enable Amplifier Support via MAX9744

config FIRMWARE_USE_MDNS
    bool "Enable mDNS broadcasts"
    default false
    help
        Enable mDNS broadcasts for web service


config FIRMWARE_USE_AWS
    bool "Enable AWS"
    depends on AWS_IOT_SDK
    default false
    help
        Enable AWS support


config FIRMWARE_USE_HOMEKIT
    bool "Enable Homekit"
    depends on FIRMWARE_USE_TEMPERATURE_SI7021
    default false
    help
        Enable Homekit support

config FIRMWARE_FORCE_HOMEKIT_PIN_DEFAULT
    bool "Use default Homekit pin"
    depends on FIRMWARE_USE_HOMEKIT
    default true
    help
        Use default Homekit pin

config FIRMWARE_USE_OTA
    bool "Enable OTA updater"
    default true
    help
        Enable OTA updater

config FIRMWARE_OTA_MANIFEST_URL
    string "OTA update manifest URL"
    depends on FIRMWARE_USE_OTA
    default ""
    help
        OTA update manifest URL

config FIRMWARE_USE_WEB
    bool "Enable Web"
    default false
    help
        Enables Web interface

config FIRMWARE_TEMPERATURE_HTTP_ENDPOINT
    bool "Enable HTTP sensor server"
    default false
    help
        Enables temperature HTTP endpoint

config FIRMWARE_TEMPERATURE_HTTP_ENDPOINT_URL
    string "Temperature update endpoint URL"
    depends on FIRMWARE_TEMPERATURE_HTTP_ENDPOINT
    default ""
    help
        Temperature HTTP endpoint URL


config FIRMWARE_TEMPERATURE_UDP_ENDPOINT
    bool "Enable UDP sensor server"
    default true
    help
        Enables UDP temperature endpoint

config FIRMWARE_TEMPERATURE_UDP_IP
    string "Remote IP address of UDP sensor server"
    depends on FIRMWARE_TEMPERATURE_UDP_ENDPOINT
    default "192.168.40.10"
    help
        Remote IP address of UDP sensor server

config FIRMWARE_TEMPERATURE_UDP_PORT
    int "Remote port address of UDP sensor server"
    depends on FIRMWARE_TEMPERATURE_UDP_ENDPOINT
    default 8445
    help
        Remote port address of UDP sensor server

config FIRMWARE_WEB_MAX_CONNECTIONS
    int "Maximum simultaneous web connections"
    depends on FIRMWARE_USE_WEB
    default 5
    help
        Maximum simultaneous web connections

config FIRMWARE_WEB_PORT
    int "Listen port for web interface"
    depends on FIRMWARE_USE_WEB
    default 80
    help
        Listen port for web interface

config FIRMWARE_USE_WEB_WEBSOCKET
    bool "Enable Websockets in web interface"
    depends on FIRMWARE_USE_WEB
    default false
    help
        Enable Websockets in web interface

choice
    prompt "Enable Temperature Sensor"
    default FIRMWARE_USE_TEMPERATURE_OFF
    
    config FIRMWARE_USE_TEMPERATURE_OFF
        bool "None"
    help
        Disable temperature sensor support

    config FIRMWARE_USE_TEMPERATURE_DHT11
        bool "dht11"
    help
        Use DHT11 sensor

    config FIRMWARE_USE_TEMPERATURE_SI7021
        bool "si7021"
    help
        Use si7021 sensor
endchoice

config FIRMWARE_USE_CONSOLE
    bool "Enable console interface"
    default true
    help
        Enable console interface

config FIRMWARE_HARDCODE_WIFI
    bool "Hardcode wifi credentials"
    default true
    help
        Builds wifi credentials into firmware binary

config FIRMWARE_DEFAULT_VOLUME
    int "Default volume level"
    depends on FIRMWARE_USE_AMP
    default 27
    help
        Default volume level

config FIRMWARE_MINIMUM_VOLUME
    int "Minimum volume level"
    depends on FIRMWARE_USE_AMP
    default 0
    help
        Minimum volume level

config FIRMWARE_MAXIMUM_VOLUME
    int "Maximum volume level"
    depends on FIRMWARE_USE_AMP
    default 63
    help
        Maximum volume level


config FIRMWARE_ERROR_GPIO
    int "GPIO for error LED"
    default 16
    help
        GPIO for error LED

config FIRMWARE_READY_GPIO
    int "GPIO for ready LED"
    default 17
    help
        GPIO for ready LED

config FIRMWARE_IDENTIFY_GPIO
    int "GPIO for identify LED"
    default 18
    help
        GPIO for identify LED


config FIRMWARE_USE_UDP_LOGGING
    bool "Enable UDP logging"
    default true
    help
        Enables UDP logging

config FIRMWARE_UDP_LOGGING_IP
    string "Remote IP address of UDP logging server"
    depends on FIRMWARE_USE_UDP_LOGGING
    default "192.168.20.10"
    help
        Remote IP address of UDP logging server

config FIRMWARE_UDP_LOGGING_PORT
    int "Remote port of UDP logging server"
    depends on FIRMWARE_USE_UDP_LOGGING
    default 8444
    help
        Remote port of UDP logging server

endmenu
```

## sdkconfig.defaults
```kconfig
CONFIG_PYTHON="python2"

CONFIG_FREERTOS_ASSERT_ON_UNTESTED_FUNCTION=
CONFIG_MAKE_WARN_UNDEFINED_VARIABLES=y

# partitions

CONFIG_PARTITION_TABLE_SINGLE_APP=
CONFIG_PARTITION_TABLE_TWO_OTA=
CONFIG_PARTITION_TABLE_CUSTOM=y
CONFIG_PARTITION_TABLE_CUSTOM_FILENAME="partitions.csv"
CONFIG_PARTITION_TABLE_CUSTOM_APP_BIN_OFFSET=0x10000
CONFIG_PARTITION_TABLE_CUSTOM_PHY_DATA_OFFSET=0xf000
CONFIG_PARTITION_TABLE_FILENAME="partitions.csv"
CONFIG_APP_OFFSET=0x10000
CONFIG_PHY_DATA_OFFSET=0xf000
CONFIG_PARTITION_TABLE_MD5=y

CONFIG_ESPTOOLPY_FLASHSIZE="4MB"
CONFIG_ESPTOOLPY_FLASHSIZE_4MB=y

CONFIG_ESPTOOLPY_PORT="/dev/cu.SLAB_USBtoUART"
CONFIG_ESPTOOLPY_BAUD_115200B=
CONFIG_ESPTOOLPY_BAUD_230400B=
CONFIG_ESPTOOLPY_BAUD_921600B=y
CONFIG_ESPTOOLPY_BAUD_2MB=
CONFIG_ESPTOOLPY_BAUD_OTHER=
CONFIG_ESPTOOLPY_BAUD_OTHER_VAL=115200
CONFIG_ESPTOOLPY_BAUD=921600
CONFIG_ESPTOOLPY_COMPRESSED=y
CONFIG_MONITOR_BAUD_9600B=
CONFIG_MONITOR_BAUD_57600B=
CONFIG_MONITOR_BAUD_115200B=
CONFIG_MONITOR_BAUD_230400B=
CONFIG_MONITOR_BAUD_921600B=y
CONFIG_MONITOR_BAUD_2MB=
CONFIG_MONITOR_BAUD_OTHER=
CONFIG_MONITOR_BAUD_OTHER_VAL=115200
CONFIG_MONITOR_BAUD=921600
CONFIG_CONSOLE_UART_DEFAULT=y
CONFIG_CONSOLE_UART_CUSTOM=
CONFIG_CONSOLE_UART_NONE=
CONFIG_CONSOLE_UART_NUM=0
CONFIG_CONSOLE_UART_BAUDRATE=921600

#
# Bluetooth
#
CONFIG_BT_ENABLED=y
CONFIG_BTDM_CONTROLLER_PINNED_TO_CORE_0=y
CONFIG_BTDM_CONTROLLER_PINNED_TO_CORE_1=
CONFIG_BTDM_CONTROLLER_PINNED_TO_CORE=0
CONFIG_BTDM_CONTROLLER_HCI_MODE_VHCI=y
CONFIG_BTDM_CONTROLLER_HCI_MODE_UART_H4=
CONFIG_BLUEDROID_ENABLED=y
CONFIG_BLUEDROID_PINNED_TO_CORE_0=y
CONFIG_BLUEDROID_PINNED_TO_CORE_1=
CONFIG_BLUEDROID_PINNED_TO_CORE=0
CONFIG_BTC_TASK_STACK_SIZE=3072
CONFIG_BLUEDROID_MEM_DEBUG=
CONFIG_CLASSIC_BT_ENABLED=
CONFIG_GATTS_ENABLE=y
CONFIG_GATTC_ENABLE=y
CONFIG_BLE_SMP_ENABLE=y
CONFIG_BT_STACK_NO_LOG=
CONFIG_BT_ACL_CONNECTIONS=4
CONFIG_SMP_ENABLE=y
CONFIG_BT_RESERVE_DRAM=0x10000

# wdt

CONFIG_INT_WDT=y
CONFIG_INT_WDT_TIMEOUT_MS=300
CONFIG_INT_WDT_CHECK_CPU1=y
CONFIG_TASK_WDT=y
CONFIG_TASK_WDT_PANIC=
CONFIG_TASK_WDT_TIMEOUT_S=5
CONFIG_TASK_WDT_CHECK_IDLE_TASK_CPU0=y
CONFIG_TASK_WDT_CHECK_IDLE_TASK_CPU1=y


# wifi

CONFIG_ESP32_PHY_CALIBRATION_AND_DATA_STORAGE=
CONFIG_ESP32_PHY_INIT_DATA_IN_PARTITION=
CONFIG_ESP32_WIFI_NVS_ENABLED=

# lock the CPU frequency to 80Mhz to avoid RMT issues
CONFIG_PM_ENABLE=
CONFIG_ESP32_DEFAULT_CPU_FREQ_80=y
CONFIG_ESP32_DEFAULT_CPU_FREQ_160=
CONFIG_ESP32_DEFAULT_CPU_FREQ_240=
CONFIG_ESP32_DEFAULT_CPU_FREQ_MHZ=80

# set sane stack sizes

CONFIG_SYSTEM_EVENT_TASK_STACK_SIZE=3072
CONFIG_MAIN_TASK_STACK_SIZE=8192
CONFIG_IPC_TASK_STACK_SIZE=1536
CONFIG_TIMER_TASK_STACK_SIZE=3584
CONFIG_IDLE_TASK_STACK_SIZE=1536


CONFIG_ESP_ERR_TO_NAME_LOOKUP=y

#
# Bootloader config
#
CONFIG_LOG_BOOTLOADER_LEVEL_NONE=
CONFIG_LOG_BOOTLOADER_LEVEL_ERROR=
CONFIG_LOG_BOOTLOADER_LEVEL_WARN=y
CONFIG_LOG_BOOTLOADER_LEVEL_INFO=
CONFIG_LOG_BOOTLOADER_LEVEL_DEBUG=
CONFIG_LOG_BOOTLOADER_LEVEL_VERBOSE=
CONFIG_LOG_BOOTLOADER_LEVEL=2
CONFIG_BOOTLOADER_VDDSDIO_BOOST_1_8V=
CONFIG_BOOTLOADER_VDDSDIO_BOOST_1_9V=y

# release mode + save flash size

CONFIG_OPTIMIZATION_LEVEL_DEBUG=
CONFIG_OPTIMIZATION_LEVEL_RELEASE=y
CONFIG_OPTIMIZATION_ASSERTIONS_ENABLED=
CONFIG_OPTIMIZATION_ASSERTIONS_SILENT=y
CONFIG_OPTIMIZATION_ASSERTIONS_DISABLED=

# memory protection

CONFIG_CXX_EXCEPTIONS=y
CONFIG_CXX_EXCEPTIONS_EMG_POOL_SIZE=0
CONFIG_STACK_CHECK_NONE=
CONFIG_STACK_CHECK_NORM=
CONFIG_STACK_CHECK_STRONG=
CONFIG_STACK_CHECK_ALL=y
CONFIG_STACK_CHECK=y

CONFIG_FREERTOS_CHECK_STACKOVERFLOW_NONE=
CONFIG_FREERTOS_CHECK_STACKOVERFLOW_PTRVAL=
CONFIG_FREERTOS_CHECK_STACKOVERFLOW_CANARY=y


CONFIG_HEAP_POISONING_DISABLED=
CONFIG_HEAP_POISONING_LIGHT=
CONFIG_HEAP_POISONING_COMPREHENSIVE=y
CONFIG_HEAP_TRACING=
CONFIG_WARN_WRITE_STRINGS=


CONFIG_ESP32_PANIC_PRINT_HALT=
CONFIG_ESP32_PANIC_PRINT_REBOOT=y
CONFIG_ESP32_PANIC_SILENT_REBOOT=
CONFIG_ESP32_PANIC_GDBSTUB=
CONFIG_ESP32_DEBUG_OCDAWARE=

# dhcp responder

CONFIG_LWIP_MULTICAST_PING=y
CONFIG_LWIP_BROADCAST_PING=y

# hardware acceleration

CONFIG_MBEDTLS_HARDWARE_AES=y
CONFIG_MBEDTLS_HARDWARE_MPI=y
CONFIG_MBEDTLS_MPI_USE_INTERRUPT=y
CONFIG_MBEDTLS_HARDWARE_SHA=y

# logging output
CONFIG_LOG_DEFAULT_LEVEL_NONE=
CONFIG_LOG_DEFAULT_LEVEL_ERROR=
CONFIG_LOG_DEFAULT_LEVEL_WARN=y
CONFIG_LOG_DEFAULT_LEVEL_INFO=
CONFIG_LOG_DEFAULT_LEVEL_DEBUG=
CONFIG_LOG_DEFAULT_LEVEL_VERBOSE=
CONFIG_LOG_DEFAULT_LEVEL=2
CONFIG_LOG_COLORS=y

# aws 

CONFIG_AWS_IOT_SDK=y
CONFIG_AWS_IOT_MQTT_HOST="a2ilo8j9t13k8m.iot.us-east-1.amazonaws.com"
CONFIG_AWS_IOT_MQTT_PORT=8883
CONFIG_AWS_IOT_MQTT_TX_BUF_LEN=512
CONFIG_AWS_IOT_MQTT_RX_BUF_LEN=512
CONFIG_AWS_IOT_MQTT_NUM_SUBSCRIBE_HANDLERS=5
CONFIG_AWS_IOT_MQTT_MIN_RECONNECT_WAIT_INTERVAL=1000
CONFIG_AWS_IOT_MQTT_MAX_RECONNECT_WAIT_INTERVAL=128000

#
# Thing Shadow
#
CONFIG_AWS_IOT_OVERRIDE_THING_SHADOW_RX_BUFFER=
CONFIG_AWS_IOT_SHADOW_MAX_SIZE_OF_UNIQUE_CLIENT_ID_BYTES=80
CONFIG_AWS_IOT_SHADOW_MAX_SIMULTANEOUS_ACKS=10
CONFIG_AWS_IOT_SHADOW_MAX_SIMULTANEOUS_THINGNAMES=10
CONFIG_AWS_IOT_SHADOW_MAX_JSON_TOKEN_EXPECTED=120
CONFIG_AWS_IOT_SHADOW_MAX_SHADOW_TOPIC_LENGTH_WITHOUT_THINGNAME=60
CONFIG_AWS_IOT_SHADOW_MAX_SIZE_OF_THING_NAME=20

#
# MAX9744 audio amplifier
#
CONFIG_MAX9744_ESPIDF_ENABLED=y
CONFIG_MAX9744_ESPIDF_I2C_SDA_GPIO=21
CONFIG_MAX9744_ESPIDF_I2C_SCL_GPIO=22

# components

CONFIG_NKOLBAN=y


#
# TarableSSD1306
#
CONFIG_SSD1306_ENABLE_DEFAULT_I2C_INTERFACE=y
CONFIG_SSD1306_DEFAULT_I2C_SPEED=250000
CONFIG_SSD1306_DEFAULT_I2C_PORT_NUMBER=1
CONFIG_SSD1306_DEFAULT_I2C_SCL_PIN=5
CONFIG_SSD1306_DEFAULT_I2C_SDA_PIN=4
CONFIG_SSD1306_ENABLE_DEFAULT_SPI_INTERFACE=
CONFIG_SSD1306_ERROR_ABORT=
CONFIG_SSD1306_CLIPDEBUG=1
CONFIG_CLIPDEBUG_NONE=
CONFIG_CLIPDEBUG_WARNING=y
CONFIG_CLIPDEBUG_ERROR=

# needed for Mongoose mbedTLS support
CONFIG_MBEDTLS_PSK_MODES=y
CONFIG_MBEDTLS_KEY_EXCHANGE_PSK=y

#
# Mongoose
#
CONFIG_MONGOOSE_TLS=0
CONFIG_MONGOOSE_TLS_NONE=
CONFIG_MONGOOSE_TLS_OPENSSL=
CONFIG_MONGOOSE_TLS_MBEDTLS=y
```
